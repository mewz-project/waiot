## src/platforms/esp32/main/Kconfig.projbuild
```kconfig
menu "Waiot Features"

config USE_TFLM
    bool "Enable WASI-NN with TensorFlow Lite Micro"
    default y

endmenu
```

## src/platforms/esp32/sdkconfig.defaults
```kconfig
CONFIG_FREERTOS_USE_TRACE_FACILITY=y
# CONFIG_ESP_SYSTEM_MEMPROT_FEATURE is not set
CONFIG_PARTITION_TABLE_CUSTOM=y
CONFIG_PARTITION_TABLE_CUSTOM_FILENAME="partitions.csv"
CONFIG_WAMR_INTERP_CLASSIC=y
# CONFIG_WAMR_INTERP_FAST is not set
# CONFIG_WAMR_ENABLE_LIB_PTHREAD is not set
CONFIG_WAMR_ENABLE_REF_TYPES=y
```

## src/runtime/platforms/esp32/sdkconfig.defaults
```kconfig
CONFIG_FREERTOS_USE_TRACE_FACILITY=y
# CONFIG_ESP_SYSTEM_MEMPROT_FEATURE is not set
CONFIG_PARTITION_TABLE_CUSTOM=y
CONFIG_PARTITION_TABLE_CUSTOM_FILENAME="partitions.csv"
# CAMERA
CONFIG_SPIRAM_SUPPORT=y
CONFIG_SPIRAM_BOOT_INIT=y
CONFIG_ESP32_SPIRAM_SUPPORT=y
CONFIG_ESP32_DEFAULT_PTHREAD_CORE_0=y
CONFIG_ESP32S2_TRAX=n
CONFIG_MBEDTLS_DYNAMIC_BUFFER=y
CONFIG_SPIFFS_MAX_PARTITIONS=3
CONFIG_SPIFFS_PAGE_CHECK=y
CONFIG_ESPTOOLPY_FLASHSIZE_4MB=y
CONFIG_ESPTOOLPY_FLASHFREQ_80M=y
CONFIG_ESPTOOLPY_FLASHMODE_QIO=y
CONFIG_SPIRAM_SPEED_80M=y
CONFIG_SPIRAM_USE_CAPS_ALLOC=y
CONFIG_S16=y
CONFIG_ESP_INT_WDT=n
CONFIG_ESP_TASK_WDT=n
```
